## components/wp_board/Kconfig
```kconfig
menu "Panel board"
    choice WP_BOARD
        prompt "Panel hardware"
        default WP_BOARD_WAVESHARE_43
        help
            The panel the firmware is built for. Each board has its own sdkconfig defaults in
            boards/<name>.defaults; build with idf.py -D WP_BOARD=<name>.
        config WP_BOARD_WAVESHARE_43
            bool "Waveshare ESP32-S3-Touch-LCD-4.3 (800x480 RGB, GT911, CH422G)"
        config WP_BOARD_WT32_SC01_PLUS
            bool "Wireless-Tag WT32-SC01 Plus (480x320 ST7796 i80, FT6336)"
        config WP_BOARD_ESP32_2424S012
            bool "ESP32-2424S012 (ESP32-C3, round 240x240 GC9A01 SPI, CST816D)"
    endchoice

    config WP_WIFI_MAX_TX_POWER_QDBM
        int "WiFi TX power limit (0.25 dBm units, 0 = no limit)"
        default 0
        range 0 84
        help
            Some boards' antennas are so poorly matched that the access point never hears
            them at full power. 34 = 8.5 dBm.

    menu "LCD"
        config LCD_I80_PCLK_MHZ
            depends on WP_BOARD_WT32_SC01_PLUS
            int "i80 write clock (MHz)"
            default 20
            range 2 40

        config LCD_RGB_BOUNCE_BUFFER_HEIGHT
            int "RGB Bounce buffer height"
            default 10
            help
                Height of bounce buffer. The width of the buffer is the same as that of the LCD.

    endmenu

    menu "LVGL"
        config LVGL_PORT_TASK_MAX_DELAY_MS
            int "LVGL timer task maximum delay (ms)"
            default 500
            range 2 2000  # Example range, adjust as needed
            help
            The maximum delay of the LVGL timer task, in milliseconds.

        config LVGL_PORT_TASK_MIN_DELAY_MS
            int "LVGL timer task minimum delay (ms)"
            default 10
            range 1 100  # Example range, adjust as needed
            help
            The minimum delay of the LVGL timer task, in milliseconds.

        config LVGL_PORT_TASK_PRIORITY
            int "LVGL task priority"
            default 2
            help
                The Board Support Package will create a task that will periodically handle LVGL operation in lv_timer_handler().

        config LVGL_PORT_TASK_STACK_SIZE_KB
            int "LVGL task stack size (KB)"
            default 16
            help
                Size(KB) of LVGL task stack.

        config LVGL_PORT_TASK_CORE
            int "LVGL timer task core"
            default -1
            range -1 1
            help
            The core of the LVGL timer task.
            Set to -1 to not specify the core.
            Set to 1 only if the SoCs support dual-core, otherwise set to -1 or 0.

        config LVGL_PORT_TICK
            int "LVGL tick period"
            default 2
            range 1 100
            help
                Period of LVGL tick timer.

        config LVGL_PORT_AVOID_TEAR_ENABLE
            bool "Avoid tearing effect"
            default "n"
            help
                Avoid tearing effect through LVGL buffer mode and double frame buffers of RGB LCD. This feature is only available for RGB LCD.

        choice
            depends on LVGL_PORT_AVOID_TEAR_ENABLE
            prompt "Select Avoid Tearing Mode"
            default LVGL_PORT_AVOID_TEAR_MODE_3
            config LVGL_PORT_AVOID_TEAR_MODE_1
                bool "Mode1: LCD double-buffer & LVGL full-refresh"
            config LVGL_PORT_AVOID_TEAR_MODE_2
                bool "Mode2: LCD triple-buffer & LVGL full-refresh"
            config LVGL_PORT_AVOID_TEAR_MODE_3
                bool "Mode3: LCD double-buffer & LVGL direct-mode"
            help
                The current tearing prevention mode supports both full refresh mode and direct mode. Tearing prevention mode may consume more PSRAM space
        endchoice

        config LVGL_PORT_AVOID_TEAR_MODE
            depends on LVGL_PORT_AVOID_TEAR_ENABLE
            int
            default 1 if LVGL_PORT_AVOID_TEAR_MODE_1
            default 2 if LVGL_PORT_AVOID_TEAR_MODE_2
            default 3 if LVGL_PORT_AVOID_TEAR_MODE_3

        choice
            depends on LVGL_PORT_AVOID_TEAR_ENABLE
            prompt "Select rotation"
            default LVGL_PORT_ROTATION_0
            config LVGL_PORT_ROTATION_0
                bool "Rotation 0"
            config LVGL_PORT_ROTATION_90
                bool "Rotation 90"
            config LVGL_PORT_ROTATION_180
                bool "Rotation 180"
            config LVGL_PORT_ROTATION_270
                bool "Rotation 270"
        endchoice

        config LVGL_PORT_ROTATION_DEGREE
            int
            default 0 if LVGL_PORT_ROTATION_0
            default 90 if LVGL_PORT_ROTATION_90
            default 180 if LVGL_PORT_ROTATION_180
            default 270 if LVGL_PORT_ROTATION_270

        choice
            depends on !LVGL_PORT_AVOID_TEAR_ENABLE
            prompt "Select LVGL buffer memory capability"
            default LVGL_PORT_BUF_INTERNAL
            config LVGL_PORT_BUF_PSRAM
                bool "PSRAM memory"
            config LVGL_PORT_BUF_INTERNAL
                bool "Internal memory"
        endchoice

        config LVGL_PORT_BUF_HEIGHT
            depends on !LVGL_PORT_AVOID_TEAR_ENABLE
            int "LVGL buffer height"
            default 100
            help
                Height of LVGL buffer. The width of the buffer is the same as that of the LCD.
    endmenu
endmenu
```
